## sdkconfig.defaults
```kconfig
# Rust often needs a bit of an extra main task stack size compared to C (the default is 3K)
CONFIG_ESP_MAIN_TASK_STACK_SIZE=8000

# Use this to set FreeRTOS kernel tick frequency to 1000 Hz (100 Hz by default).
# This allows to use 1 ms granularity for thread sleeps (10 ms by default).
#CONFIG_FREERTOS_HZ=1000

# Workaround for https://github.com/espressif/esp-idf/issues/7631
#CONFIG_MBEDTLS_CERTIFICATE_BUNDLE=n
#CONFIG_MBEDTLS_CERTIFICATE_BUNDLE_DEFAULT_FULL=n


## PSRAM
# Enable PSRAM
CONFIG_ESP32_SPIRAM_SUPPORT=y
CONFIG_SPIRAM_USE=y

# Set PSRAM clock and mode according to your hardware
CONFIG_SPIRAM_SPEED_80M=y
# If you have issues with 80MHz, try 40MHz
# CONFIG_SPIRAM_SPEED_40M=y

# PSRAM allocation strategies
CONFIG_SPIRAM_MALLOC_ALWAYSINTERNAL=16384
CONFIG_SPIRAM_MALLOC_RESERVE_INTERNAL=32768

# Allow memory allocation in PSRAM for large allocations
CONFIG_SPIRAM_ALLOW_STACK_EXTERNAL_MEMORY=y
CONFIG_SPIRAM_ALLOW_BSS_SEG_EXTERNAL_MEMORY=y

# Tell the compiler to prefer PSRAM for large allocations
CONFIG_SPIRAM_FETCH_INSTRUCTIONS=y
CONFIG_SPIRAM_RODATA=y

CONFIG_COMPILER_OPTIMIZATION_SIZE=y
```
